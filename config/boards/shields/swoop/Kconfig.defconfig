## config/boards/shields/swoop/Kconfig.defconfig
```kconfig
if SHIELD_SWOOP_LEFT || SHIELD_SWOOP_RIGHT

config ZMK_SPLIT
	default y

if SHIELD_SWOOP_RIGHT

config ZMK_KEYBOARD_NAME
	default "Swoop"

if ZMK_BLE
config ZMK_SPLIT_BLE_ROLE_CENTRAL
	default y
endif

#SHIELD_SWOOP_RIGHT
endif

if SHIELD_SWOOP_LEFT

#SHIELD_SWOOP_LEFT
endif

# SHIELD_SWOOP_RIGHT || SHIELD_SWOOP_LEFT
endif

CONFIG_BUILD_OUTPUT_UF2=y
```
